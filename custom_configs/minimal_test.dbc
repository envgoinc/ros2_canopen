VERSION ""

NS_ :

BS_:

BU_: VCU Slave

BO_ 182 Slave_TPDO1 : 8 VCU
 SG_ Value : 0|32@1+ (1,0) [0|4294967295] "" VCU
 SG_ Status : 32|8@1+ (1,0) [0|255] "" VCU

BO_ 202 Slave_RPDO1 : 8 VCU
 SG_ Command : 0|32@1+ (1,0) [0|4294967295] "" VCU
 SG_ Control : 32|8@1+ (1,0) [0|255] "" VCU

BO_ 123 TestMessage : 8 VCU
 SG_ Data : 0|8@1+ (1,0) [0|255] "" VCU
